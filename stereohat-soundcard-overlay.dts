// Simple driver for Hifiberry and ICS43432 MEMS microphone compatible hardware
/dts-v1/;
/plugin/;

/ {
	compatible = "brcm,bcm2708";

	fragment@0 {
		target = <&i2s>;
		__overlay__ {
			status = "okay";
		};
	};

	fragment@2 {
		target-path = "/";
		__overlay__ {
			stereohat-codec {
				#sound-dai-cells = <0>;
				compatible = "stereohat,stereohat";
				status = "okay";
			};
		};
	};

	fragment@3 {
		target = <&sound>;
		__overlay__ {
			compatible = "stereohat,stereohat-soundcard";
			i2s-controller = <&i2s>;
			status = "okay";
		};
	};
};
